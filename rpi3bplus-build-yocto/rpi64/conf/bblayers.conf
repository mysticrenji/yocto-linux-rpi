## rpi3bplus-build-yocto/rpi64/conf/bblayers.conf
```bitbake
# POKY_BBLAYERS_CONF_VERSION is increased each time build/conf/bblayers.conf
# changes incompatibly
POKY_BBLAYERS_CONF_VERSION = "2"

BBPATH = "${TOPDIR}"
BBFILES ?= ""

BBLAYERS ?= " \
  /home/kenshin/Downloads/rpi3bplus-build-yocto/rpi3bplus-build-yocto/poky/meta \
  /home/kenshin/Downloads/rpi3bplus-build-yocto/rpi3bplus-build-yocto/poky/meta-poky \
  /home/kenshin/Downloads/rpi3bplus-build-yocto/rpi3bplus-build-yocto/poky/meta-yocto-bsp \
  /home/kenshin/Downloads/rpi3bplus-build-yocto/rpi3bplus-build-yocto/meta-raspberrypi \
  /home/kenshin/Downloads/rpi3bplus-build-yocto/rpi3bplus-build-yocto/meta-openembedded/meta-oe \
  /home/kenshin/Downloads/rpi3bplus-build-yocto/rpi3bplus-build-yocto/meta-openembedded/meta-python \
  /home/kenshin/Downloads/rpi3bplus-build-yocto/rpi3bplus-build-yocto/meta-openembedded/meta-perl \
  /home/kenshin/Downloads/rpi3bplus-build-yocto/rpi3bplus-build-yocto/meta-openembedded/meta-networking \
  /home/kenshin/Downloads/rpi3bplus-build-yocto/rpi3bplus-build-yocto/meta-openembedded/meta-filesystems \
  /home/kenshin/Downloads/rpi3bplus-build-yocto/rpi3bplus-build-yocto/meta-virtualization \
  "
```

## rpi3bplus-build-yocto/rpi64/conf/local.conf
```bitbake
MACHINE ??= "raspberrypi3-64"
CORE_IMAGE_EXTRA_INSTALL += "kernel-modules htop openssh python3 iperf3 docker-ce bash ntp "
 
INHERIT += "extrausers"
 
EXTRA_USERS_PARAMS += " useradd pi; \
                       usermod  -p 'raspberry' pi; \
                       usermod  -a -G sudo pi; \
                       usermod -P root root; "
 
DISTRO_FEATURES_append = " virtualization bluez5 bluetooth wifi"
IMAGE_INSTALL_append = " linux-firmware-bcm43430 bluez5 i2c-tools bridge-utils hostapd dhcp-server iptables wpa-supplicant"
```
